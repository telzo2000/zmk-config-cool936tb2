## config/boards/shields/cool936tb/Kconfig.shield
```kconfig
config SHIELD_COOL936TB_R
    def_bool $(shields_list_contains,cool936tb_R)

config SHIELD_COOL936TB_L
    def_bool $(shields_list_contains,cool936tb_L)
```

## config/boards/shields/cool936tb2/Kconfig.defconfig
```kconfig
if SHIELD_COOL936TB2_R

config ZMK_KEYBOARD_NAME
    default "cool936tb2_R"

config ZMK_SPLIT
    default y

config ZMK_SPLIT_ROLE_CENTRAL
    default y

endif

if SHIELD_COOL936TB2_L

config ZMK_KEYBOARD_NAME
    default "cool936tb2_L"

config ZMK_SPLIT
    default y

endif
```

## config/boards/shields/cool936tb2/Kconfig.shield
```kconfig
config SHIELD_COOLl936TB2_R
    def_bool $(shields_list_contains,cool936tb2_R)

config SHIELD_COOL936TB2_L
    def_bool $(shields_list_contains,cool936tb2_L)
```

## config/west.yml
```yaml
manifest:
  remotes:
    - name: zmkfirmware
      url-base: https://github.com/zmkfirmware
    - name: telzo2000
      url-base: https://github.com/telzo2000
    - name: caksoylar  # <-- new entry
      url-base: https://github.com/caksoylar 
     - name: kot149
      url-base: https://github.com/kot149 
  projects:
    - name: zmk
      remote: zmkfirmware
      revision: main
      import: app/west.yml
    - name: zmk-pmw3610-driver
      remote: telzo2000
      revision: main
    - name: zmk-rgbled-widget  # <-- new entry
      remote: caksoylar
      revision: main
    - name: zmk-layout-shift
      remote: kot149
      revision: v1
  self:
    path: config
```
